AUTOSAR XML (schema 4-2-2)
package /ActiveEcuC
  module config Adc: implementation-config-variant=VARIANT-POST-BUILD, module-description=Adc_Impl
    AdcGeneral:
      AdcDeInitApi = true
      AdcDevErrorDetect = false
      AdcEnableLimitCheck = false
      AdcEnableQueuing = true
      AdcEnableStartStopGroupApi = true
      AdcGrpNotifCapability = true
      AdcHwTriggerApi = true
      AdcPriorityImplementation = ADC_PRIORITY_HW_SW
      AdcReadGroupApi = true
      AdcResultAlignment = ADC_ALIGN_RIGHT
      AdcVersionInfoApi = true
      AdcGetStreamLastPointerApi = true
      AdcDeviceName = BGA516
      AdcVersionCheckExternalModules = true
      AdcCriticalSectionProtection = true
      AdcAlreadyInitDetCheck = true
      AdcFunctionalityMode = ADC_POLLING_INTERRUPT_MODE
      AdcEnableStreaming = true
      AdcEnableAdTimer = true
      AdcEnableDma = true
      AdcEnableSelfDiag = true
      AdcEnableIdErr = false
      AdcEnableParityErr = false
      AdcEnableOverWriteErr = false
      AdcEnableTriggerOverlapErr = false
      AdcEnableDisableChSupport = true
      AdcHwUnitVirtualChannel = ADC_39_39_39_39
      AdcLowPowerStatesSupport = false
      AdcPowerStateAsynchTransitionMode = false
      AdcInterruptConsistencyCheck = true
      AdcIsrCategory = CAT1
      AdcPeNumber = 0
    AdcConfigSet
      AdcHwUnit:
        AdcHwUnitId = ADC_HWUNIT_0
        AdcHwUnitResolution = ADC_12_BIT
        AdcClockSource = NOT_USED
        AdcEnableInterruptErr = true
        AdcErrorNotification = IoHwAb_Adc_ErrNotification
        AdcErrorNotificationScanGroup = IoHwAb_Adc_ErrNotificationSG
        AdcPrescale = 0
        AdcChannel:
          AdcChannelId = 1
          AdcChannelConvTime = 0
          AdcChannelHighLimit = 5
          AdcChannelLimitCheck = false
          AdcChannelLowLimit = 0
          AdcChannelRangeSelect = ADC_RANGE_ALWAYS
          AdcChannelRefVoltsrcHigh = NOT_USED
          AdcChannelRefVoltsrcLow = NOT_USED
          AdcChannelResolution = 1
          AdcChannelSampTime = 0
          AdcEnableChSelfDiag = false
          AdcSelfDiagConvCktRef = AVREFH_MUL_BY_0
        AdcGroup:
          AdcGroupAccessMode = ADC_ACCESS_MODE_SINGLE
          AdcGroupConversionMode = ADC_CONV_MODE_ONESHOT
          AdcGroupId = 0
          AdcGroupTriggSrc = ADC_TRIGG_SRC_SW
          AdcStreamingBufferMode = ADC_STREAM_BUFFER_LINEAR
          AdcStreamingNumSamples = 1
          AdcScanGroup = 1
          AdcEnableWiringBreakDetection = false
          AdcEnableDmaTransfer = true
          AdcEnableAdTimerTriggMode = false
          AdcGroupPriority = 0
          AdcGroupReplacement = ADC_GROUP_REPL_ABORT_RESTART
          AdcHwTrigSignal = ADC_HW_TRIG_RISING_EDGE
          AdcHwTrigTimer = 0
          AdcNotification = IoHwAb_Adc_Notification_Group0
          AdcSelfDiagMode = ADC_SELF_DIAG_OFF
          AdcSelfDiagPinLevel = LEVEL_1
          AdcTimerPeriod = 0
          AdcTimerPhaseDelay = 0
          AdcWiringBreakPulseWidth = 1
          AdcTAUUnitChannel = TAUD0I0
          AdcGroupDefinition = AdcChannel
          AdcGroupDefinition = AdcChannel_001
          AdcGroupDefinition = AdcChannel_002
          AdcGroupDefinition = AdcChannel_004
        AdcHwScanGroup: AdcScanGroupId=1, AdcSGProcessingMode=ADC_INTERRUPT_MODE, AdcSGDmaChannel=DMA0_09, AdcSGQueueSize=1, AdcSoftwareWaitTimeSelect=0
        AdcHwScanGroup_001 (AdcHwScanGroup): AdcScanGroupId=4, AdcSGProcessingMode=ADC_POLLING_MODE, AdcSGQueueSize=4, AdcSoftwareWaitTimeSelect=8, AdcSGDmaChannel=DMA0_15
        AdcGroup_002 (AdcGroup):
          AdcGroupAccessMode = ADC_ACCESS_MODE_SINGLE
          AdcGroupConversionMode = ADC_CONV_MODE_ONESHOT
          AdcGroupId = 2
          AdcGroupTriggSrc = ADC_TRIGG_SRC_HW
          AdcStreamingBufferMode = ADC_STREAM_BUFFER_LINEAR
          AdcStreamingNumSamples = 1
          AdcScanGroup = 4
          AdcEnableWiringBreakDetection = false
          AdcEnableDmaTransfer = false
          AdcEnableAdTimerTriggMode = false
          AdcGroupPriority = 5
          AdcGroupReplacement = ADC_GROUP_REPL_ABORT_RESTART
          AdcHwTrigSignal = ADC_HW_TRIG_RISING_EDGE
          AdcHwTrigTimer = 0
          AdcNotification = IoHwAb_Adc_Notification_Group1
          AdcSelfDiagMode = ADC_SELF_DIAG_OFF
          AdcSelfDiagPinLevel = LEVEL_1
          AdcTimerPeriod = 0
          AdcTimerPhaseDelay = 0
          AdcWiringBreakPulseWidth = 1
          AdcTAUUnitChannel = TAUD0I15
          AdcGroupDefinition = AdcChannel
          AdcGroupHwTriggerSource = AdcHwUnit/AdcHwTriggerConfig
          AdcGroupDefinition = AdcChannel_001
          AdcGroupHwTriggerSource = AdcHwTriggerConfig_001
        3 x AdcChannel, all with AdcChannelConvTime=0, AdcChannelHighLimit=5, AdcChannelLimitCheck=false, AdcChannelLowLimit=0, AdcChannelRefVoltsrcHigh=NOT_USED, AdcChannelRefVoltsrcLow=NOT_USED, AdcChannelResolution=1, AdcChannelSampTime=0, AdcEnableChSelfDiag=false, AdcSelfDiagConvCktRef=AVREFH_MUL_BY_0:
          AdcChannel_001: AdcChannelId=2, AdcChannelRangeSelect=ADC_RANGE_ALWAYS
          AdcChannel_002: AdcChannelId=4, AdcChannelRangeSelect=ADC_RANGE_ALWAYS
          AdcChannel_004: AdcChannelId=5, AdcChannelRangeSelect=ADC_RANGE_OVER_HIGH
        AdcHwTriggerConfig: AdcHwTrigger=TSEL_TAUn
        AdcGroup_003 (AdcGroup):
          AdcGroupAccessMode = ADC_ACCESS_MODE_SINGLE
          AdcGroupConversionMode = ADC_CONV_MODE_ONESHOT
          AdcGroupId = 3
          AdcGroupTriggSrc = ADC_TRIGG_SRC_HW
          AdcStreamingBufferMode = ADC_STREAM_BUFFER_LINEAR
          AdcStreamingNumSamples = 1
          AdcEnableDmaTransfer = false
          AdcEnableWiringBreakDetection = false
          AdcScanGroup = 4
          AdcGroupPriority = 3
          AdcHwTrigSignal = ADC_HW_TRIG_RISING_EDGE
          AdcGroupReplacement = ADC_GROUP_REPL_ABORT_RESTART
          AdcSelfDiagMode = ADC_SELF_DIAG_OFF
          AdcSelfDiagPinLevel = LEVEL_1
          AdcTimerPeriod = 0
          AdcTimerPhaseDelay = 0
          AdcWiringBreakPulseWidth = 1
          AdcNotification = IoHwAb_Adc_Notification_Group005
          AdcTAUUnitChannel = TAUD1I0
          AdcGroupDefinition = AdcChannel_001
          AdcGroupHwTriggerSource = AdcHwUnit/AdcHwTriggerConfig
          AdcGroupDefinition = AdcChannel_002
          AdcGroupDefinition = AdcChannel_004
        AdcHwTriggerConfig_001 (AdcHwTriggerConfig): AdcHwTrigger=TSEL_TAUn
        AdcGroup_005 (AdcGroup):
          AdcGroupAccessMode = ADC_ACCESS_MODE_SINGLE
          AdcGroupConversionMode = ADC_CONV_MODE_ONESHOT
          AdcGroupId = 5
          AdcGroupTriggSrc = ADC_TRIGG_SRC_HW
          AdcStreamingBufferMode = ADC_STREAM_BUFFER_LINEAR
          AdcStreamingNumSamples = 1
          AdcEnableDmaTransfer = false
          AdcEnableWiringBreakDetection = false
          AdcScanGroup = 4
          AdcGroupPriority = 5
          AdcHwTrigSignal = ADC_HW_TRIG_RISING_EDGE
          AdcGroupReplacement = ADC_GROUP_REPL_ABORT_RESTART
          AdcSelfDiagMode = ADC_SELF_DIAG_OFF
          AdcSelfDiagPinLevel = LEVEL_1
          AdcTimerPeriod = 0
          AdcTimerPhaseDelay = 0
          AdcWiringBreakPulseWidth = 1
          AdcNotification = IoHwAb_Adc_Notification_Group005
          AdcTAUUnitChannel = TAUD0I0
          AdcGroupDefinition = AdcChannel_001
          AdcGroupHwTriggerSource = AdcHwUnit/AdcHwTriggerConfig
          AdcGroupDefinition = AdcChannel_002
          AdcGroupDefinition = AdcChannel_004
        AdcSGSoftwareWaitTimeInformation:
          AdcSGSoftwareWaitTime_0 = 370
          AdcSGSoftwareWaitTime_1 = 360
          AdcSGSoftwareWaitTime_2 = 350
          AdcSGSoftwareWaitTime_3 = 400
          AdcSGSoftwareWaitTime_4 = 300
          AdcSGSoftwareWaitTime_5 = 200
          AdcSGSoftwareWaitTime_6 = 100
          AdcSGSoftwareWaitTime_7 = 0
      AdcHwUnit_002 (AdcHwUnit):
        AdcHwUnitId = ADC_HWUNIT_2
        AdcHwUnitResolution = ADC_12_BIT
        AdcClockSource = NOT_USED
        AdcErrorNotification = IoHwAb_Adc_ErrNotification1
        AdcErrorNotificationScanGroup = IoHwAb_Adc_ErrNotificationSG
        AdcChannel_006 (AdcChannel): AdcChannelId=2, AdcChannelLimitCheck=false, AdcChannelLowLimit=1234, AdcChannelRangeSelect=ADC_RANGE_ALWAYS
        AdcGroup_001 (AdcGroup):
          AdcGroupAccessMode = ADC_ACCESS_MODE_SINGLE
          AdcGroupConversionMode = ADC_CONV_MODE_ONESHOT
          AdcGroupId = 1
          AdcGroupTriggSrc = ADC_TRIGG_SRC_HW
          AdcStreamingBufferMode = ADC_STREAM_BUFFER_LINEAR
          AdcStreamingNumSamples = 1
          AdcEnableDmaTransfer = true
          AdcEnableWiringBreakDetection = false
          AdcScanGroup = 0
          AdcNotification = IoHwAb_Adc_Notification_Group003
          AdcGroupPriority = 1
          AdcSelfDiagMode = ADC_SELF_DIAG_PIN_LVL
          AdcSelfDiagPinLevel = LEVEL_4
          AdcHwTrigSignal = ADC_HW_TRIG_FALLING_EDGE
          AdcTimerPhaseDelay = 3
          AdcTAUUnitChannel = TAUD1I15
          AdcGroupDefinition = AdcChannel_003
          AdcGroupHwTriggerSource = AdcHwUnit_002/AdcHwTriggerConfig
          AdcGroupDefinition = AdcChannel_005
          AdcGroupDefinition = AdcChannel_006
        AdcHwScanGroup: AdcScanGroupId=0, AdcSGProcessingMode=ADC_INTERRUPT_MODE, AdcSGQueueSize=10, AdcSGDmaChannel=DMA1_05, AdcSoftwareWaitTimeSelect=0
        AdcChannel_003 (AdcChannel): AdcChannelId=0, AdcChannelLimitCheck=false, AdcEnableChSelfDiag=true, AdcSelfDiagConvCktRef=AVREFH_MUL_3_DIV_BY_4
        AdcChannel_005 (AdcChannel): AdcChannelId=1, AdcChannelRefVoltsrcHigh=NOT_USED, AdcChannelRefVoltsrcLow=NOT_USED
        AdcGroup_004 (AdcGroup):
          AdcGroupAccessMode = ADC_ACCESS_MODE_SINGLE
          AdcGroupConversionMode = ADC_CONV_MODE_ONESHOT
          AdcGroupId = 4
          AdcGroupTriggSrc = ADC_TRIGG_SRC_HW
          AdcStreamingBufferMode = ADC_STREAM_BUFFER_LINEAR
          AdcStreamingNumSamples = 1
          AdcEnableDmaTransfer = false
          AdcEnableWiringBreakDetection = false
          AdcScanGroup = 4
          AdcNotification = IoHwAb_Adc_Notification_Group004
          AdcGroupPriority = 4
          AdcSelfDiagMode = ADC_SELF_DIAG_WIRE_BRK
          AdcWiringBreakPulseWidth = 17
          AdcHwTrigSignal = ADC_HW_TRIG_RISING_EDGE
          AdcTAUUnitChannel = TAUJ1I3
          AdcGroupHwTriggerSource = AdcHwUnit_002/AdcHwTriggerConfig
          AdcGroupDefinition = AdcChannel_005
        AdcHwScanGroup_001 (AdcHwScanGroup): AdcScanGroupId=4, AdcSGProcessingMode=ADC_POLLING_MODE, AdcSGQueueSize=10, AdcSoftwareWaitTimeSelect=4, AdcSGDmaChannel=DMA1_09
        AdcHwTriggerConfig: AdcHwTrigger=TSEL_ADTRGn
        AdcSGSoftwareWaitTimeInformation:
          AdcSGSoftwareWaitTime_0 = 0
          AdcSGSoftwareWaitTime_1 = 100
          AdcSGSoftwareWaitTime_2 = 200
          AdcSGSoftwareWaitTime_3 = 300
          AdcSGSoftwareWaitTime_4 = 400
          AdcSGSoftwareWaitTime_5 = 50
          AdcSGSoftwareWaitTime_6 = 60
          AdcSGSoftwareWaitTime_7 = 70
    AdcPublishedInformation: AdcChannelValueSigned=false, AdcGroupFirstChannelFixed=false, AdcMaxChannelResolution=12
    AdcDemEventParameterRefs:
      ADC_E_ID_FAILURE = DemEventParameter_001
      ADC_E_PARITY_FAILURE = DemEventParameter_003
      ADC_E_WRITE_TIMEOUT_FAILURE = DemEventParameter_005
      ADC_E_INT_INCONSISTENT = DemEventParameter_002
