AUTOSAR XML (schema 4-2-2)
# COPYRIGHT
# (c) 2016-2017 Renesas Electronics Corporation. All rights reserved.
package /Renesas/EcucDefs_Adc
  bsw implementation Adc_Impl: programming-language=C, sw-version=2.0.0, vendor-id=59, ar-release-version=4.2.2, behavior=BswInternalBehavior_0, vendor-specific-module-def=Adc
    code-descriptors:
      code Adc_Code: artifact-descriptors=[{short-label=Adc.c, category=SWSRC}, {short-label=Adc.h, category=SWHDR}]
    resource consumption ResourceConsumption
      15 x memory section:
        PUBLIC_CODE: sw-addrmethod=CODE
        PRIVATE_CODE: sw-addrmethod=CODE
        APPL_CODE: sw-addrmethod=CODE
        CODE_FAST: sw-addrmethod=CODE
        CONST_32: sw-addrmethod=CONST
        CONFIG_DATA_8: sw-addrmethod=CONFIG_DATA
        CONFIG_DATA_16: sw-addrmethod=CONFIG_DATA
        CONFIG_DATA_32: sw-addrmethod=CONFIG_DATA
        CONFIG_DATA_UNSPECIFIED: sw-addrmethod=CONFIG_DATA
        DBTOC_DATA_UNSPECIFIED: sw-addrmethod=CONFIG_DATA
        VAR_INIT_BOOLEAN: sw-addrmethod=VAR_INIT
        VAR_NO_INIT_BOOLEAN: sw-addrmethod=VAR_NO_INIT
        VAR_NO_INIT_8: sw-addrmethod=VAR_NO_INIT
        VAR_NO_INIT_32: sw-addrmethod=VAR_NO_INIT
        VAR_NO_INIT_UNSPECIFIED: sw-addrmethod=VAR_NO_INIT
  bsw module description AdcInternalBehavior: module-id=123
    provided-entrys:
      Adc_Init
      Adc_DeInit
      Adc_StartGroupConversion
      Adc_StopGroupConversion
      Adc_ReadGroup
      Adc_EnableHardwareTrigger
      Adc_DisableHardwareTrigger
      Adc_EnableGroupNotification
      Adc_DisableGroupNotification
      Adc_GetGroupStatus
      Adc_GetStreamLastPointer
      Adc_SetupResultBuffer
      Adc_GetVersionInfo
      Adc_DisableChannel
      Adc_EnableChannel
      ADC0_SG{0..4}_CAT2_ISR
      ADC0_ERR_CAT2_ISR
      ADC1_SG{0..4}_CAT2_ISR
      ADC1_ERR_CAT2_ISR
      ADC2_SG{0..4}_CAT2_ISR
      ADC2_ERR_CAT2_ISR
      ADC3_SG{0..4}_CAT2_ISR
      ADC3_ERR_CAT2_ISR
      ADC_DMA0_CH{00..15}_CAT2_ISR
      ADC_DMA1_CH{00..15}_CAT2_ISR
    bsw internal behavior BswInternalBehavior_0
      exclusive area RAMDATA_PROTECTION
      exclusive area INTERRUPT_CONTROL_PROTECTION_AREA
      112 x bsw interrupt entity:
        BswInterruptEntity_0: adc-enter-exclusive-area=[ADC_RAMDATA_PROTECTION, INTERRUPT_CONTROL_PROTECTION_AREA], implemented-entry=ADC0_SG0_ISR, interrupt-category=CAT-1, interrupt-source=EIINT249
        BswInterruptEntity_1: adc-enter-exclusive-area=[ADC_RAMDATA_PROTECTION, INTERRUPT_CONTROL_PROTECTION_AREA], implemented-entry=ADC0_SG0_CAT2_ISR, interrupt-category=CAT-2, interrupt-source=EIINT249
        BswInterruptEntity_2: adc-enter-exclusive-area=[ADC_RAMDATA_PROTECTION, INTERRUPT_CONTROL_PROTECTION_AREA], implemented-entry=ADC0_SG1_ISR, interrupt-category=CAT-1, interrupt-source=EIINT250
        BswInterruptEntity_3: adc-enter-exclusive-area=[ADC_RAMDATA_PROTECTION, INTERRUPT_CONTROL_PROTECTION_AREA], implemented-entry=ADC0_SG1_CAT2_ISR, interrupt-category=CAT-2, interrupt-source=EIINT250
        BswInterruptEntity_4: adc-enter-exclusive-area=[ADC_RAMDATA_PROTECTION, INTERRUPT_CONTROL_PROTECTION_AREA], implemented-entry=ADC0_SG2_ISR, interrupt-category=CAT-1, interrupt-source=EIINT251
        BswInterruptEntity_5: adc-enter-exclusive-area=[ADC_RAMDATA_PROTECTION, INTERRUPT_CONTROL_PROTECTION_AREA], implemented-entry=ADC0_SG2_CAT2_ISR, interrupt-category=CAT-2, interrupt-source=EIINT251
        BswInterruptEntity_6: adc-enter-exclusive-area=[ADC_RAMDATA_PROTECTION, INTERRUPT_CONTROL_PROTECTION_AREA], implemented-entry=ADC0_SG3_ISR, interrupt-category=CAT-1, interrupt-source=EIINT252
        BswInterruptEntity_7: adc-enter-exclusive-area=[ADC_RAMDATA_PROTECTION, INTERRUPT_CONTROL_PROTECTION_AREA], implemented-entry=ADC0_SG3_CAT2_ISR, interrupt-category=CAT-2, interrupt-source=EIINT252
        BswInterruptEntity_8: adc-enter-exclusive-area=[ADC_RAMDATA_PROTECTION, INTERRUPT_CONTROL_PROTECTION_AREA], implemented-entry=ADC0_SG4_ISR, interrupt-category=CAT-1, interrupt-source=EIINT253
        BswInterruptEntity_9: adc-enter-exclusive-area=[ADC_RAMDATA_PROTECTION, INTERRUPT_CONTROL_PROTECTION_AREA], implemented-entry=ADC0_SG4_CAT2_ISR, interrupt-category=CAT-2, interrupt-source=EIINT253
        BswInterruptEntity_10: implemented-entry=ADC0_ERR_ISR, interrupt-category=CAT-1, interrupt-source=EIINT269
        BswInterruptEntity_11: implemented-entry=ADC0_ERR_CAT2_ISR, interrupt-category=CAT-2, interrupt-source=EIINT269
        BswInterruptEntity_12: adc-enter-exclusive-area=[ADC_RAMDATA_PROTECTION, INTERRUPT_CONTROL_PROTECTION_AREA], implemented-entry=ADC1_SG0_ISR, interrupt-category=CAT-1, interrupt-source=EIINT259
        BswInterruptEntity_13: adc-enter-exclusive-area=[ADC_RAMDATA_PROTECTION, INTERRUPT_CONTROL_PROTECTION_AREA], implemented-entry=ADC1_SG0_CAT2_ISR, interrupt-category=CAT-2, interrupt-source=EIINT259
        BswInterruptEntity_14: adc-enter-exclusive-area=[ADC_RAMDATA_PROTECTION, INTERRUPT_CONTROL_PROTECTION_AREA], implemented-entry=ADC1_SG1_ISR, interrupt-category=CAT-1, interrupt-source=EIINT260
        BswInterruptEntity_15: adc-enter-exclusive-area=[ADC_RAMDATA_PROTECTION, INTERRUPT_CONTROL_PROTECTION_AREA], implemented-entry=ADC1_SG1_CAT2_ISR, interrupt-category=CAT-2, interrupt-source=EIINT260
        BswInterruptEntity_16: adc-enter-exclusive-area=[ADC_RAMDATA_PROTECTION, INTERRUPT_CONTROL_PROTECTION_AREA], implemented-entry=ADC1_SG2_ISR, interrupt-category=CAT-1, interrupt-source=EIINT261
        BswInterruptEntity_17: adc-enter-exclusive-area=[ADC_RAMDATA_PROTECTION, INTERRUPT_CONTROL_PROTECTION_AREA], implemented-entry=ADC1_SG2_CAT2_ISR, interrupt-category=CAT-2, interrupt-source=EIINT261
        BswInterruptEntity_18: adc-enter-exclusive-area=[ADC_RAMDATA_PROTECTION, INTERRUPT_CONTROL_PROTECTION_AREA], implemented-entry=ADC1_SG3_ISR, interrupt-category=CAT-1, interrupt-source=EIINT262
        BswInterruptEntity_19: adc-enter-exclusive-area=[ADC_RAMDATA_PROTECTION, INTERRUPT_CONTROL_PROTECTION_AREA], implemented-entry=ADC1_SG3_CAT2_ISR, interrupt-category=CAT-2, interrupt-source=EIINT262
        BswInterruptEntity_20: adc-enter-exclusive-area=[ADC_RAMDATA_PROTECTION, INTERRUPT_CONTROL_PROTECTION_AREA], implemented-entry=ADC1_SG4_ISR, interrupt-category=CAT-1, interrupt-source=EIINT263
        BswInterruptEntity_21: adc-enter-exclusive-area=[ADC_RAMDATA_PROTECTION, INTERRUPT_CONTROL_PROTECTION_AREA], implemented-entry=ADC1_SG4_CAT2_ISR, interrupt-category=CAT-2, interrupt-source=EIINT263
        BswInterruptEntity_22: implemented-entry=ADC1_ERR_ISR, interrupt-category=CAT-1, interrupt-source=EIINT271
        BswInterruptEntity_23: implemented-entry=ADC1_ERR_CAT2_ISR, interrupt-category=CAT-2, interrupt-source=EIINT271
        BswInterruptEntity_24: adc-enter-exclusive-area=[ADC_RAMDATA_PROTECTION, INTERRUPT_CONTROL_PROTECTION_AREA], implemented-entry=ADC2_SG0_ISR, interrupt-category=CAT-1, interrupt-source=EIINT254
        BswInterruptEntity_25: adc-enter-exclusive-area=[ADC_RAMDATA_PROTECTION, INTERRUPT_CONTROL_PROTECTION_AREA], implemented-entry=ADC2_SG0_CAT2_ISR, interrupt-category=CAT-2, interrupt-source=EIINT254
        BswInterruptEntity_26: adc-enter-exclusive-area=[ADC_RAMDATA_PROTECTION, INTERRUPT_CONTROL_PROTECTION_AREA], implemented-entry=ADC2_SG1_ISR, interrupt-category=CAT-1, interrupt-source=EIINT255
        BswInterruptEntity_27: adc-enter-exclusive-area=[ADC_RAMDATA_PROTECTION, INTERRUPT_CONTROL_PROTECTION_AREA], implemented-entry=ADC2_SG1_CAT2_ISR, interrupt-category=CAT-2, interrupt-source=EIINT255
        BswInterruptEntity_28: adc-enter-exclusive-area=[ADC_RAMDATA_PROTECTION, INTERRUPT_CONTROL_PROTECTION_AREA], implemented-entry=ADC2_SG2_ISR, interrupt-category=CAT-1, interrupt-source=EIINT256
        BswInterruptEntity_29: adc-enter-exclusive-area=[ADC_RAMDATA_PROTECTION, INTERRUPT_CONTROL_PROTECTION_AREA], implemented-entry=ADC2_SG2_CAT2_ISR, interrupt-category=CAT-2, interrupt-source=EIINT256
        BswInterruptEntity_30: adc-enter-exclusive-area=[ADC_RAMDATA_PROTECTION, INTERRUPT_CONTROL_PROTECTION_AREA], implemented-entry=ADC2_SG3_ISR, interrupt-category=CAT-1, interrupt-source=EIINT257
        BswInterruptEntity_31: adc-enter-exclusive-area=[ADC_RAMDATA_PROTECTION, INTERRUPT_CONTROL_PROTECTION_AREA], implemented-entry=ADC2_SG3_CAT2_ISR, interrupt-category=CAT-2, interrupt-source=EIINT257
        BswInterruptEntity_32: adc-enter-exclusive-area=[ADC_RAMDATA_PROTECTION, INTERRUPT_CONTROL_PROTECTION_AREA], implemented-entry=ADC2_SG4_ISR, interrupt-category=CAT-1, interrupt-source=EIINT258
        BswInterruptEntity_33: adc-enter-exclusive-area=[ADC_RAMDATA_PROTECTION, INTERRUPT_CONTROL_PROTECTION_AREA], implemented-entry=ADC2_SG4_CAT2_ISR, interrupt-category=CAT-2, interrupt-source=EIINT258
        BswInterruptEntity_34: implemented-entry=ADC2_ERR_ISR, interrupt-category=CAT-1, interrupt-source=EIINT270
        BswInterruptEntity_35: implemented-entry=ADC2_ERR_CAT2_ISR, interrupt-category=CAT-2, interrupt-source=EIINT270
        BswInterruptEntity_36: adc-enter-exclusive-area=[ADC_RAMDATA_PROTECTION, INTERRUPT_CONTROL_PROTECTION_AREA], implemented-entry=ADC3_SG0_ISR, interrupt-category=CAT-1, interrupt-source=EIINT264
        BswInterruptEntity_37: adc-enter-exclusive-area=[ADC_RAMDATA_PROTECTION, INTERRUPT_CONTROL_PROTECTION_AREA], implemented-entry=ADC3_SG0_CAT2_ISR, interrupt-category=CAT-2, interrupt-source=EIINT264
        BswInterruptEntity_38: adc-enter-exclusive-area=[ADC_RAMDATA_PROTECTION, INTERRUPT_CONTROL_PROTECTION_AREA], implemented-entry=ADC3_SG1_ISR, interrupt-category=CAT-1, interrupt-source=EIINT265
        BswInterruptEntity_39: adc-enter-exclusive-area=[ADC_RAMDATA_PROTECTION, INTERRUPT_CONTROL_PROTECTION_AREA], implemented-entry=ADC3_SG1_CAT2_ISR, interrupt-category=CAT-2, interrupt-source=EIINT265
        BswInterruptEntity_40: adc-enter-exclusive-area=[ADC_RAMDATA_PROTECTION, INTERRUPT_CONTROL_PROTECTION_AREA], implemented-entry=ADC3_SG2_ISR, interrupt-category=CAT-1, interrupt-source=EIINT266
        BswInterruptEntity_41: adc-enter-exclusive-area=[ADC_RAMDATA_PROTECTION, INTERRUPT_CONTROL_PROTECTION_AREA], implemented-entry=ADC3_SG2_CAT2_ISR, interrupt-category=CAT-2, interrupt-source=EIINT266
        BswInterruptEntity_42: adc-enter-exclusive-area=[ADC_RAMDATA_PROTECTION, INTERRUPT_CONTROL_PROTECTION_AREA], implemented-entry=ADC3_SG3_ISR, interrupt-category=CAT-1, interrupt-source=EIINT267
        BswInterruptEntity_43: adc-enter-exclusive-area=[ADC_RAMDATA_PROTECTION, INTERRUPT_CONTROL_PROTECTION_AREA], implemented-entry=ADC3_SG3_CAT2_ISR, interrupt-category=CAT-2, interrupt-source=EIINT267
        BswInterruptEntity_44: adc-enter-exclusive-area=[ADC_RAMDATA_PROTECTION, INTERRUPT_CONTROL_PROTECTION_AREA], implemented-entry=ADC3_SG4_ISR, interrupt-category=CAT-1, interrupt-source=EIINT268
        BswInterruptEntity_45: adc-enter-exclusive-area=[ADC_RAMDATA_PROTECTION, INTERRUPT_CONTROL_PROTECTION_AREA], implemented-entry=ADC3_SG4_CAT2_ISR, interrupt-category=CAT-2, interrupt-source=EIINT268
        BswInterruptEntity_46: implemented-entry=ADC3_ERR_ISR, interrupt-category=CAT-1, interrupt-source=EIINT272
        BswInterruptEntity_47: implemented-entry=ADC3_ERR_CAT2_ISR, interrupt-category=CAT-2, interrupt-source=EIINT272
        BswInterruptEntity_48: adc-enter-exclusive-area=INTERRUPT_CONTROL_PROTECTION_AREA, implemented-entry=ADC_DMA0_CH00_ISR, interrupt-category=CAT-1, interrupt-source=EIC45
        BswInterruptEntity_49: adc-enter-exclusive-area=INTERRUPT_CONTROL_PROTECTION_AREA, implemented-entry=ADC_DMA0_CH00_CAT2_ISR, interrupt-category=CAT-2, interrupt-source=EIC45
        BswInterruptEntity_50: adc-enter-exclusive-area=INTERRUPT_CONTROL_PROTECTION_AREA, implemented-entry=ADC_DMA0_CH01_ISR, interrupt-category=CAT-1, interrupt-source=EIC46
        BswInterruptEntity_51: adc-enter-exclusive-area=INTERRUPT_CONTROL_PROTECTION_AREA, implemented-entry=ADC_DMA0_CH01_CAT2_ISR, interrupt-category=CAT-2, interrupt-source=EIC46
        BswInterruptEntity_52: adc-enter-exclusive-area=INTERRUPT_CONTROL_PROTECTION_AREA, implemented-entry=ADC_DMA0_CH02_ISR, interrupt-category=CAT-1, interrupt-source=EIC47
        BswInterruptEntity_53: adc-enter-exclusive-area=INTERRUPT_CONTROL_PROTECTION_AREA, implemented-entry=ADC_DMA0_CH02_CAT2_ISR, interrupt-category=CAT-2, interrupt-source=EIC47
        BswInterruptEntity_54: adc-enter-exclusive-area=INTERRUPT_CONTROL_PROTECTION_AREA, implemented-entry=ADC_DMA0_CH03_ISR, interrupt-category=CAT-1, interrupt-source=EIC48
        BswInterruptEntity_55: adc-enter-exclusive-area=INTERRUPT_CONTROL_PROTECTION_AREA, implemented-entry=ADC_DMA0_CH03_CAT2_ISR, interrupt-category=CAT-2, interrupt-source=EIC48
        BswInterruptEntity_56: adc-enter-exclusive-area=INTERRUPT_CONTROL_PROTECTION_AREA, implemented-entry=ADC_DMA0_CH04_ISR, interrupt-category=CAT-1, interrupt-source=EIC49
        BswInterruptEntity_57: adc-enter-exclusive-area=INTERRUPT_CONTROL_PROTECTION_AREA, implemented-entry=ADC_DMA0_CH04_CAT2_ISR, interrupt-category=CAT-2, interrupt-source=EIC49
        BswInterruptEntity_58: adc-enter-exclusive-area=INTERRUPT_CONTROL_PROTECTION_AREA, implemented-entry=ADC_DMA0_CH05_ISR, interrupt-category=CAT-1, interrupt-source=EIC50
        BswInterruptEntity_59: adc-enter-exclusive-area=INTERRUPT_CONTROL_PROTECTION_AREA, implemented-entry=ADC_DMA0_CH05_CAT2_ISR, interrupt-category=CAT-2, interrupt-source=EIC50
        BswInterruptEntity_60: adc-enter-exclusive-area=INTERRUPT_CONTROL_PROTECTION_AREA, implemented-entry=ADC_DMA0_CH06_ISR, interrupt-category=CAT-1, interrupt-source=EIC51
        BswInterruptEntity_61: adc-enter-exclusive-area=INTERRUPT_CONTROL_PROTECTION_AREA, implemented-entry=ADC_DMA0_CH06_CAT2_ISR, interrupt-category=CAT-2, interrupt-source=EIC51
        BswInterruptEntity_62: adc-enter-exclusive-area=INTERRUPT_CONTROL_PROTECTION_AREA, implemented-entry=ADC_DMA0_CH07_ISR, interrupt-category=CAT-1, interrupt-source=EIC52
        BswInterruptEntity_63: adc-enter-exclusive-area=INTERRUPT_CONTROL_PROTECTION_AREA, implemented-entry=ADC_DMA0_CH07_CAT2_ISR, interrupt-category=CAT-2, interrupt-source=EIC52
        BswInterruptEntity_64: adc-enter-exclusive-area=INTERRUPT_CONTROL_PROTECTION_AREA, implemented-entry=ADC_DMA0_CH08_ISR, interrupt-category=CAT-1, interrupt-source=EIC53
        BswInterruptEntity_65: adc-enter-exclusive-area=INTERRUPT_CONTROL_PROTECTION_AREA, implemented-entry=ADC_DMA0_CH08_CAT2_ISR, interrupt-category=CAT-2, interrupt-source=EIC53
        BswInterruptEntity_66: adc-enter-exclusive-area=INTERRUPT_CONTROL_PROTECTION_AREA, implemented-entry=ADC_DMA0_CH09_ISR, interrupt-category=CAT-1, interrupt-source=EIC54
        BswInterruptEntity_67: adc-enter-exclusive-area=INTERRUPT_CONTROL_PROTECTION_AREA, implemented-entry=ADC_DMA0_CH09_CAT2_ISR, interrupt-category=CAT-2, interrupt-source=EIC54
        BswInterruptEntity_68: adc-enter-exclusive-area=INTERRUPT_CONTROL_PROTECTION_AREA, implemented-entry=ADC_DMA0_CH10_ISR, interrupt-category=CAT-1, interrupt-source=EIC55
        BswInterruptEntity_69: adc-enter-exclusive-area=INTERRUPT_CONTROL_PROTECTION_AREA, implemented-entry=ADC_DMA0_CH10_CAT2_ISR, interrupt-category=CAT-2, interrupt-source=EIC55
        BswInterruptEntity_70: adc-enter-exclusive-area=INTERRUPT_CONTROL_PROTECTION_AREA, implemented-entry=ADC_DMA0_CH11_ISR, interrupt-category=CAT-1, interrupt-source=EIC56
        BswInterruptEntity_71: adc-enter-exclusive-area=INTERRUPT_CONTROL_PROTECTION_AREA, implemented-entry=ADC_DMA0_CH11_CAT2_ISR, interrupt-category=CAT-2, interrupt-source=EIC56
        BswInterruptEntity_72: adc-enter-exclusive-area=INTERRUPT_CONTROL_PROTECTION_AREA, implemented-entry=ADC_DMA0_CH12_ISR, interrupt-category=CAT-1, interrupt-source=EIC57
        BswInterruptEntity_73: adc-enter-exclusive-area=INTERRUPT_CONTROL_PROTECTION_AREA, implemented-entry=ADC_DMA0_CH12_CAT2_ISR, interrupt-category=CAT-2, interrupt-source=EIC57
        BswInterruptEntity_74: adc-enter-exclusive-area=INTERRUPT_CONTROL_PROTECTION_AREA, implemented-entry=ADC_DMA0_CH13_ISR, interrupt-category=CAT-1, interrupt-source=EIC58
        BswInterruptEntity_75: adc-enter-exclusive-area=INTERRUPT_CONTROL_PROTECTION_AREA, implemented-entry=ADC_DMA0_CH13_CAT2_ISR, interrupt-category=CAT-2, interrupt-source=EIC58
        BswInterruptEntity_76: adc-enter-exclusive-area=INTERRUPT_CONTROL_PROTECTION_AREA, implemented-entry=ADC_DMA0_CH14_ISR, interrupt-category=CAT-1, interrupt-source=EIC59
        BswInterruptEntity_77: adc-enter-exclusive-area=INTERRUPT_CONTROL_PROTECTION_AREA, implemented-entry=ADC_DMA0_CH14_CAT2_ISR, interrupt-category=CAT-2, interrupt-source=EIC59
        BswInterruptEntity_78: adc-enter-exclusive-area=INTERRUPT_CONTROL_PROTECTION_AREA, implemented-entry=ADC_DMA0_CH15_ISR, interrupt-category=CAT-1, interrupt-source=EIC60
        BswInterruptEntity_79: adc-enter-exclusive-area=INTERRUPT_CONTROL_PROTECTION_AREA, implemented-entry=ADC_DMA0_CH15_CAT2_ISR, interrupt-category=CAT-2, interrupt-source=EIC60
        BswInterruptEntity_80: adc-enter-exclusive-area=INTERRUPT_CONTROL_PROTECTION_AREA, implemented-entry=ADC_DMA1_CH00_ISR, interrupt-category=CAT-1, interrupt-source=EIC61
        BswInterruptEntity_81: adc-enter-exclusive-area=INTERRUPT_CONTROL_PROTECTION_AREA, implemented-entry=ADC_DMA1_CH00_CAT2_ISR, interrupt-category=CAT-2, interrupt-source=EIC61
        BswInterruptEntity_82: adc-enter-exclusive-area=INTERRUPT_CONTROL_PROTECTION_AREA, implemented-entry=ADC_DMA1_CH01_ISR, interrupt-category=CAT-1, interrupt-source=EIC62
        BswInterruptEntity_83: adc-enter-exclusive-area=INTERRUPT_CONTROL_PROTECTION_AREA, implemented-entry=ADC_DMA1_CH01_CAT2_ISR, interrupt-category=CAT-2, interrupt-source=EIC62
        BswInterruptEntity_84: adc-enter-exclusive-area=INTERRUPT_CONTROL_PROTECTION_AREA, implemented-entry=ADC_DMA1_CH02_ISR, interrupt-category=CAT-1, interrupt-source=EIC63
        BswInterruptEntity_85: adc-enter-exclusive-area=INTERRUPT_CONTROL_PROTECTION_AREA, implemented-entry=ADC_DMA1_CH02_CAT2_ISR, interrupt-category=CAT-2, interrupt-source=EIC63
        BswInterruptEntity_86: adc-enter-exclusive-area=INTERRUPT_CONTROL_PROTECTION_AREA, implemented-entry=ADC_DMA1_CH03_ISR, interrupt-category=CAT-1, interrupt-source=EIC64
        BswInterruptEntity_87: adc-enter-exclusive-area=INTERRUPT_CONTROL_PROTECTION_AREA, implemented-entry=ADC_DMA1_CH03_CAT2_ISR, interrupt-category=CAT-2, interrupt-source=EIC64
        BswInterruptEntity_88: adc-enter-exclusive-area=INTERRUPT_CONTROL_PROTECTION_AREA, implemented-entry=ADC_DMA1_CH04_ISR, interrupt-category=CAT-1, interrupt-source=EIC65
        BswInterruptEntity_89: adc-enter-exclusive-area=INTERRUPT_CONTROL_PROTECTION_AREA, implemented-entry=ADC_DMA1_CH04_CAT2_ISR, interrupt-category=CAT-2, interrupt-source=EIC65
        BswInterruptEntity_90: adc-enter-exclusive-area=INTERRUPT_CONTROL_PROTECTION_AREA, implemented-entry=ADC_DMA1_CH05_ISR, interrupt-category=CAT-1, interrupt-source=EIC66
        BswInterruptEntity_91: adc-enter-exclusive-area=INTERRUPT_CONTROL_PROTECTION_AREA, implemented-entry=ADC_DMA1_CH05_CAT2_ISR, interrupt-category=CAT-2, interrupt-source=EIC66
        BswInterruptEntity_92: adc-enter-exclusive-area=INTERRUPT_CONTROL_PROTECTION_AREA, implemented-entry=ADC_DMA1_CH06_ISR, interrupt-category=CAT-1, interrupt-source=EIC67
        BswInterruptEntity_93: adc-enter-exclusive-area=INTERRUPT_CONTROL_PROTECTION_AREA, implemented-entry=ADC_DMA1_CH06_CAT2_ISR, interrupt-category=CAT-2, interrupt-source=EIC67
        BswInterruptEntity_94: adc-enter-exclusive-area=INTERRUPT_CONTROL_PROTECTION_AREA, implemented-entry=ADC_DMA1_CH07_ISR, interrupt-category=CAT-1, interrupt-source=EIC68
        BswInterruptEntity_95: adc-enter-exclusive-area=INTERRUPT_CONTROL_PROTECTION_AREA, implemented-entry=ADC_DMA1_CH07_CAT2_ISR, interrupt-category=CAT-2, interrupt-source=EIC68
        BswInterruptEntity_96: adc-enter-exclusive-area=INTERRUPT_CONTROL_PROTECTION_AREA, implemented-entry=ADC_DMA1_CH08_ISR, interrupt-category=CAT-1, interrupt-source=EIC69
        BswInterruptEntity_97: adc-enter-exclusive-area=INTERRUPT_CONTROL_PROTECTION_AREA, implemented-entry=ADC_DMA1_CH08_CAT2_ISR, interrupt-category=CAT-2, interrupt-source=EIC69
        BswInterruptEntity_98: adc-enter-exclusive-area=INTERRUPT_CONTROL_PROTECTION_AREA, implemented-entry=ADC_DMA1_CH09_ISR, interrupt-category=CAT-1, interrupt-source=EIC70
        BswInterruptEntity_99: adc-enter-exclusive-area=INTERRUPT_CONTROL_PROTECTION_AREA, implemented-entry=ADC_DMA1_CH09_CAT2_ISR, interrupt-category=CAT-2, interrupt-source=EIC70
        BswInterruptEntity_100: adc-enter-exclusive-area=INTERRUPT_CONTROL_PROTECTION_AREA, implemented-entry=ADC_DMA1_CH10_ISR, interrupt-category=CAT-1, interrupt-source=EIC71
        BswInterruptEntity_101: adc-enter-exclusive-area=INTERRUPT_CONTROL_PROTECTION_AREA, implemented-entry=ADC_DMA1_CH10_CAT2_ISR, interrupt-category=CAT-2, interrupt-source=EIC71
        BswInterruptEntity_102: adc-enter-exclusive-area=INTERRUPT_CONTROL_PROTECTION_AREA, implemented-entry=ADC_DMA1_CH11_ISR, interrupt-category=CAT-1, interrupt-source=EIC72
        BswInterruptEntity_103: adc-enter-exclusive-area=INTERRUPT_CONTROL_PROTECTION_AREA, implemented-entry=ADC_DMA1_CH11_CAT2_ISR, interrupt-category=CAT-2, interrupt-source=EIC72
        BswInterruptEntity_104: adc-enter-exclusive-area=INTERRUPT_CONTROL_PROTECTION_AREA, implemented-entry=ADC_DMA1_CH12_ISR, interrupt-category=CAT-1, interrupt-source=EIC73
        BswInterruptEntity_105: adc-enter-exclusive-area=INTERRUPT_CONTROL_PROTECTION_AREA, implemented-entry=ADC_DMA1_CH12_CAT2_ISR, interrupt-category=CAT-2, interrupt-source=EIC73
        BswInterruptEntity_106: adc-enter-exclusive-area=INTERRUPT_CONTROL_PROTECTION_AREA, implemented-entry=ADC_DMA1_CH13_ISR, interrupt-category=CAT-1, interrupt-source=EIC74
        BswInterruptEntity_107: adc-enter-exclusive-area=INTERRUPT_CONTROL_PROTECTION_AREA, implemented-entry=ADC_DMA1_CH13_CAT2_ISR, interrupt-category=CAT-2, interrupt-source=EIC74
        BswInterruptEntity_108: adc-enter-exclusive-area=INTERRUPT_CONTROL_PROTECTION_AREA, implemented-entry=ADC_DMA1_CH14_ISR, interrupt-category=CAT-1, interrupt-source=EIC75
        BswInterruptEntity_109: adc-enter-exclusive-area=INTERRUPT_CONTROL_PROTECTION_AREA, implemented-entry=ADC_DMA1_CH14_CAT2_ISR, interrupt-category=CAT-2, interrupt-source=EIC75
        BswInterruptEntity_110: adc-enter-exclusive-area=INTERRUPT_CONTROL_PROTECTION_AREA, implemented-entry=ADC_DMA1_CH15_ISR, interrupt-category=CAT-1, interrupt-source=EIC76
        BswInterruptEntity_120: adc-enter-exclusive-area=INTERRUPT_CONTROL_PROTECTION_AREA, implemented-entry=ADC_DMA1_CH15_CAT2_ISR, interrupt-category=CAT-2, interrupt-source=EIC76
      15 x bsw called entity:
        BswCalledEntity_0: implemented-entry=Adc_Init
        BswCalledEntity_1: implemented-entry=Adc_DeInit
        BswCalledEntity_2: adc-enter-exclusive-area=[ADC_RAMDATA_PROTECTION, INTERRUPT_CONTROL_PROTECTION_AREA], implemented-entry=Adc_StartGroupConversion
        BswCalledEntity_3: adc-enter-exclusive-area=[ADC_RAMDATA_PROTECTION, INTERRUPT_CONTROL_PROTECTION_AREA], implemented-entry=Adc_StopGroupConversion
        BswCalledEntity_4: adc-enter-exclusive-area=ADC_RAMDATA_PROTECTION, implemented-entry=Adc_ReadGroup
        BswCalledEntity_5: adc-enter-exclusive-area=[ADC_RAMDATA_PROTECTION, INTERRUPT_CONTROL_PROTECTION_AREA], implemented-entry=Adc_EnableHardwareTrigger
        BswCalledEntity_6: adc-enter-exclusive-area=[ADC_RAMDATA_PROTECTION, INTERRUPT_CONTROL_PROTECTION_AREA], implemented-entry=Adc_DisableHardwareTrigger
        BswCalledEntity_7: implemented-entry=Adc_EnableGroupNotification
        BswCalledEntity_8: implemented-entry=Adc_DisableGroupNotification
        BswCalledEntity_9: adc-enter-exclusive-area=ADC_RAMDATA_PROTECTION, implemented-entry=Adc_Adc_GetGroupStatus
        BswCalledEntity_10: adc-enter-exclusive-area=ADC_RAMDATA_PROTECTION, implemented-entry=Adc_GetStreamLastPointer
        BswCalledEntity_11: implemented-entry=Adc_SetupResultBuffer
        BswCalledEntity_12: implemented-entry=Adc_GetVersionInfo
        BswCalledEntity_13: implemented-entry=Adc_DisableChannel
        BswCalledEntity_14: implemented-entry=Adc_EnableChannel
  127 x bsw module entry:
    ADC0_SG0_ISR: is-reentrant=true, is-synchronous=true, call-type=INTERRUPT, execution-context=INTERRUPT-CAT-1, sw-service-impl-policy=STANDARD
    ADC0_SG0_CAT2_ISR: is-reentrant=true, is-synchronous=true, call-type=INTERRUPT, execution-context=INTERRUPT-CAT-2, sw-service-impl-policy=STANDARD
    ADC0_SG1_ISR: is-reentrant=true, is-synchronous=true, call-type=INTERRUPT, execution-context=INTERRUPT-CAT-1, sw-service-impl-policy=STANDARD
    ADC0_SG1_CAT2_ISR: is-reentrant=true, is-synchronous=true, call-type=INTERRUPT, execution-context=INTERRUPT-CAT-2, sw-service-impl-policy=STANDARD
    ADC0_SG2_ISR: is-reentrant=true, is-synchronous=true, call-type=INTERRUPT, execution-context=INTERRUPT-CAT-1, sw-service-impl-policy=STANDARD
    ADC0_SG2_CAT2_ISR: is-reentrant=true, is-synchronous=true, call-type=INTERRUPT, execution-context=INTERRUPT-CAT-2, sw-service-impl-policy=STANDARD
    ADC0_SG3_ISR: is-reentrant=true, is-synchronous=true, call-type=INTERRUPT, execution-context=INTERRUPT-CAT-1, sw-service-impl-policy=STANDARD
    ADC0_SG3_CAT2_ISR: is-reentrant=true, is-synchronous=true, call-type=INTERRUPT, execution-context=INTERRUPT-CAT-2, sw-service-impl-policy=STANDARD
    ADC0_SG4_ISR: is-reentrant=true, is-synchronous=true, call-type=INTERRUPT, execution-context=INTERRUPT-CAT-1, sw-service-impl-policy=STANDARD
    ADC0_SG4_CAT2_ISR: is-reentrant=true, is-synchronous=true, call-type=INTERRUPT, execution-context=INTERRUPT-CAT-2, sw-service-impl-policy=STANDARD
    ADC0_ERR_ISR: is-reentrant=true, is-synchronous=true, call-type=INTERRUPT, execution-context=INTERRUPT-CAT-1, sw-service-impl-policy=STANDARD
    ADC0_ERR_CAT2_ISR: is-reentrant=true, is-synchronous=true, call-type=INTERRUPT, execution-context=INTERRUPT-CAT-2, sw-service-impl-policy=STANDARD
    ADC1_SG0_ISR: is-reentrant=true, is-synchronous=true, call-type=INTERRUPT, execution-context=INTERRUPT-CAT-1, sw-service-impl-policy=STANDARD
    ADC1_SG0_CAT2_ISR: is-reentrant=true, is-synchronous=true, call-type=INTERRUPT, execution-context=INTERRUPT-CAT-2, sw-service-impl-policy=STANDARD
    ADC1_SG1_ISR: is-reentrant=true, is-synchronous=true, call-type=INTERRUPT, execution-context=INTERRUPT-CAT-1, sw-service-impl-policy=STANDARD
    ADC1_SG1_CAT2_ISR: is-reentrant=true, is-synchronous=true, call-type=INTERRUPT, execution-context=INTERRUPT-CAT-2, sw-service-impl-policy=STANDARD
    ADC1_SG2_ISR: is-reentrant=true, is-synchronous=true, call-type=INTERRUPT, execution-context=INTERRUPT-CAT-1, sw-service-impl-policy=STANDARD
    ADC1_SG2_CAT2_ISR: is-reentrant=true, is-synchronous=true, call-type=INTERRUPT, execution-context=INTERRUPT-CAT-2, sw-service-impl-policy=STANDARD
    ADC1_SG3_ISR: is-reentrant=true, is-synchronous=true, call-type=INTERRUPT, execution-context=INTERRUPT-CAT-1, sw-service-impl-policy=STANDARD
    ADC1_SG3_CAT2_ISR: is-reentrant=true, is-synchronous=true, call-type=INTERRUPT, execution-context=INTERRUPT-CAT-2, sw-service-impl-policy=STANDARD
    ADC1_SG4_ISR: is-reentrant=true, is-synchronous=true, call-type=INTERRUPT, execution-context=INTERRUPT-CAT-1, sw-service-impl-policy=STANDARD
    ADC1_SG4_CAT2_ISR: is-reentrant=true, is-synchronous=true, call-type=INTERRUPT, execution-context=INTERRUPT-CAT-2, sw-service-impl-policy=STANDARD
    ADC1_ERR_ISR: is-reentrant=true, is-synchronous=true, call-type=INTERRUPT, execution-context=INTERRUPT-CAT-1, sw-service-impl-policy=STANDARD
    ADC1_ERR_CAT2_ISR: is-reentrant=true, is-synchronous=true, call-type=INTERRUPT, execution-context=INTERRUPT-CAT-2, sw-service-impl-policy=STANDARD
    ADC2_SG0_ISR: is-reentrant=true, is-synchronous=true, call-type=INTERRUPT, execution-context=INTERRUPT-CAT-1, sw-service-impl-policy=STANDARD
    ADC2_SG0_CAT2_ISR: is-reentrant=true, is-synchronous=true, call-type=INTERRUPT, execution-context=INTERRUPT-CAT-2, sw-service-impl-policy=STANDARD
    ADC2_SG1_ISR: is-reentrant=true, is-synchronous=true, call-type=INTERRUPT, execution-context=INTERRUPT-CAT-1, sw-service-impl-policy=STANDARD
    ADC2_SG1_CAT2_ISR: is-reentrant=true, is-synchronous=true, call-type=INTERRUPT, execution-context=INTERRUPT-CAT-2, sw-service-impl-policy=STANDARD
    ADC2_SG2_ISR: is-reentrant=true, is-synchronous=true, call-type=INTERRUPT, execution-context=INTERRUPT-CAT-1, sw-service-impl-policy=STANDARD
    ADC2_SG2_CAT2_ISR: is-reentrant=true, is-synchronous=true, call-type=INTERRUPT, execution-context=INTERRUPT-CAT-2, sw-service-impl-policy=STANDARD
    ADC2_SG3_ISR: is-reentrant=true, is-synchronous=true, call-type=INTERRUPT, execution-context=INTERRUPT-CAT-1, sw-service-impl-policy=STANDARD
    ADC2_SG3_CAT2_ISR: is-reentrant=true, is-synchronous=true, call-type=INTERRUPT, execution-context=INTERRUPT-CAT-2, sw-service-impl-policy=STANDARD
    ADC2_SG4_ISR: is-reentrant=true, is-synchronous=true, call-type=INTERRUPT, execution-context=INTERRUPT-CAT-1, sw-service-impl-policy=STANDARD
    ADC2_SG4_CAT2_ISR: is-reentrant=true, is-synchronous=true, call-type=INTERRUPT, execution-context=INTERRUPT-CAT-2, sw-service-impl-policy=STANDARD
    ADC2_ERR_ISR: is-reentrant=true, is-synchronous=true, call-type=INTERRUPT, execution-context=INTERRUPT-CAT-1, sw-service-impl-policy=STANDARD
    ADC2_ERR_CAT2_ISR: is-reentrant=true, is-synchronous=true, call-type=INTERRUPT, execution-context=INTERRUPT-CAT-2, sw-service-impl-policy=STANDARD
    ADC3_SG0_ISR: is-reentrant=true, is-synchronous=true, call-type=INTERRUPT, execution-context=INTERRUPT-CAT-1, sw-service-impl-policy=STANDARD
    ADC3_SG0_CAT2_ISR: is-reentrant=true, is-synchronous=true, call-type=INTERRUPT, execution-context=INTERRUPT-CAT-2, sw-service-impl-policy=STANDARD
    ADC3_SG1_ISR: is-reentrant=true, is-synchronous=true, call-type=INTERRUPT, execution-context=INTERRUPT-CAT-1, sw-service-impl-policy=STANDARD
    ADC3_SG1_CAT2_ISR: is-reentrant=true, is-synchronous=true, call-type=INTERRUPT, execution-context=INTERRUPT-CAT-2, sw-service-impl-policy=STANDARD
    ADC3_SG2_ISR: is-reentrant=true, is-synchronous=true, call-type=INTERRUPT, execution-context=INTERRUPT-CAT-1, sw-service-impl-policy=STANDARD
    ADC3_SG2_CAT2_ISR: is-reentrant=true, is-synchronous=true, call-type=INTERRUPT, execution-context=INTERRUPT-CAT-2, sw-service-impl-policy=STANDARD
    ADC3_SG3_ISR: is-reentrant=true, is-synchronous=true, call-type=INTERRUPT, execution-context=INTERRUPT-CAT-1, sw-service-impl-policy=STANDARD
    ADC3_SG3_CAT2_ISR: is-reentrant=true, is-synchronous=true, call-type=INTERRUPT, execution-context=INTERRUPT-CAT-2, sw-service-impl-policy=STANDARD
    ADC3_SG4_ISR: is-reentrant=true, is-synchronous=true, call-type=INTERRUPT, execution-context=INTERRUPT-CAT-1, sw-service-impl-policy=STANDARD
    ADC3_SG4_CAT2_ISR: is-reentrant=true, is-synchronous=true, call-type=INTERRUPT, execution-context=INTERRUPT-CAT-2, sw-service-impl-policy=STANDARD
    ADC3_ERR_ISR: is-reentrant=true, is-synchronous=true, call-type=INTERRUPT, execution-context=INTERRUPT-CAT-1, sw-service-impl-policy=STANDARD
    ADC3_ERR_CAT2_ISR: is-reentrant=true, is-synchronous=true, call-type=INTERRUPT, execution-context=INTERRUPT-CAT-2, sw-service-impl-policy=STANDARD
    ADC_DMA0_CH00_ISR: is-reentrant=true, is-synchronous=true, call-type=INTERRUPT, execution-context=INTERRUPT-CAT-1, sw-service-impl-policy=STANDARD
    ADC_DMA0_CH00_CAT2_ISR: is-reentrant=true, is-synchronous=true, call-type=INTERRUPT, execution-context=INTERRUPT-CAT-2, sw-service-impl-policy=STANDARD
    ADC_DMA0_CH01_ISR: is-reentrant=true, is-synchronous=true, call-type=INTERRUPT, execution-context=INTERRUPT-CAT-1, sw-service-impl-policy=STANDARD
    ADC_DMA0_CH01_CAT2_ISR: is-reentrant=true, is-synchronous=true, call-type=INTERRUPT, execution-context=INTERRUPT-CAT-2, sw-service-impl-policy=STANDARD
    ADC_DMA0_CH02_ISR: is-reentrant=true, is-synchronous=true, call-type=INTERRUPT, execution-context=INTERRUPT-CAT-1, sw-service-impl-policy=STANDARD
    ADC_DMA0_CH02_CAT2_ISR: is-reentrant=true, is-synchronous=true, call-type=INTERRUPT, execution-context=INTERRUPT-CAT-2, sw-service-impl-policy=STANDARD
    ADC_DMA0_CH03_ISR: is-reentrant=true, is-synchronous=true, call-type=INTERRUPT, execution-context=INTERRUPT-CAT-1, sw-service-impl-policy=STANDARD
    ADC_DMA0_CH03_CAT2_ISR: is-reentrant=true, is-synchronous=true, call-type=INTERRUPT, execution-context=INTERRUPT-CAT-2, sw-service-impl-policy=STANDARD
    ADC_DMA0_CH04_ISR: is-reentrant=true, is-synchronous=true, call-type=INTERRUPT, execution-context=INTERRUPT-CAT-1, sw-service-impl-policy=STANDARD
    ADC_DMA0_CH04_CAT2_ISR: is-reentrant=true, is-synchronous=true, call-type=INTERRUPT, execution-context=INTERRUPT-CAT-2, sw-service-impl-policy=STANDARD
    ADC_DMA0_CH05_ISR: is-reentrant=true, is-synchronous=true, call-type=INTERRUPT, execution-context=INTERRUPT-CAT-1, sw-service-impl-policy=STANDARD
    ADC_DMA0_CH05_CAT2_ISR: is-reentrant=true, is-synchronous=true, call-type=INTERRUPT, execution-context=INTERRUPT-CAT-2, sw-service-impl-policy=STANDARD
    ADC_DMA0_CH06_ISR: is-reentrant=true, is-synchronous=true, call-type=INTERRUPT, execution-context=INTERRUPT-CAT-1, sw-service-impl-policy=STANDARD
    ADC_DMA0_CH06_CAT2_ISR: is-reentrant=true, is-synchronous=true, call-type=INTERRUPT, execution-context=INTERRUPT-CAT-2, sw-service-impl-policy=STANDARD
    ADC_DMA0_CH07_ISR: is-reentrant=true, is-synchronous=true, call-type=INTERRUPT, execution-context=INTERRUPT-CAT-1, sw-service-impl-policy=STANDARD
    ADC_DMA0_CH07_CAT2_ISR: is-reentrant=true, is-synchronous=true, call-type=INTERRUPT, execution-context=INTERRUPT-CAT-2, sw-service-impl-policy=STANDARD
    ADC_DMA0_CH08_ISR: is-reentrant=true, is-synchronous=true, call-type=INTERRUPT, execution-context=INTERRUPT-CAT-1, sw-service-impl-policy=STANDARD
    ADC_DMA0_CH08_CAT2_ISR: is-reentrant=true, is-synchronous=true, call-type=INTERRUPT, execution-context=INTERRUPT-CAT-2, sw-service-impl-policy=STANDARD
    ADC_DMA0_CH09_ISR: is-reentrant=true, is-synchronous=true, call-type=INTERRUPT, execution-context=INTERRUPT-CAT-1, sw-service-impl-policy=STANDARD
    ADC_DMA0_CH09_CAT2_ISR: is-reentrant=true, is-synchronous=true, call-type=INTERRUPT, execution-context=INTERRUPT-CAT-2, sw-service-impl-policy=STANDARD
    ADC_DMA0_CH10_ISR: is-reentrant=true, is-synchronous=true, call-type=INTERRUPT, execution-context=INTERRUPT-CAT-1, sw-service-impl-policy=STANDARD
    ADC_DMA0_CH10_CAT2_ISR: is-reentrant=true, is-synchronous=true, call-type=INTERRUPT, execution-context=INTERRUPT-CAT-2, sw-service-impl-policy=STANDARD
    ADC_DMA0_CH11_ISR: is-reentrant=true, is-synchronous=true, call-type=INTERRUPT, execution-context=INTERRUPT-CAT-1, sw-service-impl-policy=STANDARD
    ADC_DMA0_CH11_CAT2_ISR: is-reentrant=true, is-synchronous=true, call-type=INTERRUPT, execution-context=INTERRUPT-CAT-2, sw-service-impl-policy=STANDARD
    ADC_DMA0_CH12_ISR: is-reentrant=true, is-synchronous=true, call-type=INTERRUPT, execution-context=INTERRUPT-CAT-1, sw-service-impl-policy=STANDARD
    ADC_DMA0_CH12_CAT2_ISR: is-reentrant=true, is-synchronous=true, call-type=INTERRUPT, execution-context=INTERRUPT-CAT-2, sw-service-impl-policy=STANDARD
    ADC_DMA0_CH13_ISR: is-reentrant=true, is-synchronous=true, call-type=INTERRUPT, execution-context=INTERRUPT-CAT-1, sw-service-impl-policy=STANDARD
    ADC_DMA0_CH13_CAT2_ISR: is-reentrant=true, is-synchronous=true, call-type=INTERRUPT, execution-context=INTERRUPT-CAT-2, sw-service-impl-policy=STANDARD
    ADC_DMA0_CH14_ISR: is-reentrant=true, is-synchronous=true, call-type=INTERRUPT, execution-context=INTERRUPT-CAT-1, sw-service-impl-policy=STANDARD
    ADC_DMA0_CH14_CAT2_ISR: is-reentrant=true, is-synchronous=true, call-type=INTERRUPT, execution-context=INTERRUPT-CAT-2, sw-service-impl-policy=STANDARD
    ADC_DMA0_CH15_ISR: is-reentrant=true, is-synchronous=true, call-type=INTERRUPT, execution-context=INTERRUPT-CAT-1, sw-service-impl-policy=STANDARD
    ADC_DMA0_CH15_CAT2_ISR: is-reentrant=true, is-synchronous=true, call-type=INTERRUPT, execution-context=INTERRUPT-CAT-2, sw-service-impl-policy=STANDARD
    ADC_DMA1_CH00_ISR: is-reentrant=true, is-synchronous=true, call-type=INTERRUPT, execution-context=INTERRUPT-CAT-1, sw-service-impl-policy=STANDARD
    ADC_DMA1_CH00_CAT2_ISR: is-reentrant=true, is-synchronous=true, call-type=INTERRUPT, execution-context=INTERRUPT-CAT-2, sw-service-impl-policy=STANDARD
    ADC_DMA1_CH01_ISR: is-reentrant=true, is-synchronous=true, call-type=INTERRUPT, execution-context=INTERRUPT-CAT-1, sw-service-impl-policy=STANDARD
    ADC_DMA1_CH01_CAT2_ISR: is-reentrant=true, is-synchronous=true, call-type=INTERRUPT, execution-context=INTERRUPT-CAT-2, sw-service-impl-policy=STANDARD
    ADC_DMA1_CH02_ISR: is-reentrant=true, is-synchronous=true, call-type=INTERRUPT, execution-context=INTERRUPT-CAT-1, sw-service-impl-policy=STANDARD
    ADC_DMA1_CH02_CAT2_ISR: is-reentrant=true, is-synchronous=true, call-type=INTERRUPT, execution-context=INTERRUPT-CAT-2, sw-service-impl-policy=STANDARD
    ADC_DMA1_CH03_ISR: is-reentrant=true, is-synchronous=true, call-type=INTERRUPT, execution-context=INTERRUPT-CAT-1, sw-service-impl-policy=STANDARD
    ADC_DMA1_CH03_CAT2_ISR: is-reentrant=true, is-synchronous=true, call-type=INTERRUPT, execution-context=INTERRUPT-CAT-2, sw-service-impl-policy=STANDARD
    ADC_DMA1_CH04_ISR: is-reentrant=true, is-synchronous=true, call-type=INTERRUPT, execution-context=INTERRUPT-CAT-1, sw-service-impl-policy=STANDARD
    ADC_DMA1_CH04_CAT2_ISR: is-reentrant=true, is-synchronous=true, call-type=INTERRUPT, execution-context=INTERRUPT-CAT-2, sw-service-impl-policy=STANDARD
    ADC_DMA1_CH05_ISR: is-reentrant=true, is-synchronous=true, call-type=INTERRUPT, execution-context=INTERRUPT-CAT-1, sw-service-impl-policy=STANDARD
    ADC_DMA1_CH05_CAT2_ISR: is-reentrant=true, is-synchronous=true, call-type=INTERRUPT, execution-context=INTERRUPT-CAT-2, sw-service-impl-policy=STANDARD
    ADC_DMA1_CH06_ISR: is-reentrant=true, is-synchronous=true, call-type=INTERRUPT, execution-context=INTERRUPT-CAT-1, sw-service-impl-policy=STANDARD
    ADC_DMA1_CH06_CAT2_ISR: is-reentrant=true, is-synchronous=true, call-type=INTERRUPT, execution-context=INTERRUPT-CAT-2, sw-service-impl-policy=STANDARD
    ADC_DMA1_CH07_ISR: is-reentrant=true, is-synchronous=true, call-type=INTERRUPT, execution-context=INTERRUPT-CAT-1, sw-service-impl-policy=STANDARD
    ADC_DMA1_CH07_CAT2_ISR: is-reentrant=true, is-synchronous=true, call-type=INTERRUPT, execution-context=INTERRUPT-CAT-2, sw-service-impl-policy=STANDARD
    ADC_DMA1_CH08_ISR: is-reentrant=true, is-synchronous=true, call-type=INTERRUPT, execution-context=INTERRUPT-CAT-1, sw-service-impl-policy=STANDARD
    ADC_DMA1_CH08_CAT2_ISR: is-reentrant=true, is-synchronous=true, call-type=INTERRUPT, execution-context=INTERRUPT-CAT-2, sw-service-impl-policy=STANDARD
    ADC_DMA1_CH09_ISR: is-reentrant=true, is-synchronous=true, call-type=INTERRUPT, execution-context=INTERRUPT-CAT-1, sw-service-impl-policy=STANDARD
    ADC_DMA1_CH09_CAT2_ISR: is-reentrant=true, is-synchronous=true, call-type=INTERRUPT, execution-context=INTERRUPT-CAT-2, sw-service-impl-policy=STANDARD
    ADC_DMA1_CH10_ISR: is-reentrant=true, is-synchronous=true, call-type=INTERRUPT, execution-context=INTERRUPT-CAT-1, sw-service-impl-policy=STANDARD
    ADC_DMA1_CH10_CAT2_ISR: is-reentrant=true, is-synchronous=true, call-type=INTERRUPT, execution-context=INTERRUPT-CAT-2, sw-service-impl-policy=STANDARD
    ADC_DMA1_CH11_ISR: is-reentrant=true, is-synchronous=true, call-type=INTERRUPT, execution-context=INTERRUPT-CAT-1, sw-service-impl-policy=STANDARD
    ADC_DMA1_CH11_CAT2_ISR: is-reentrant=true, is-synchronous=true, call-type=INTERRUPT, execution-context=INTERRUPT-CAT-2, sw-service-impl-policy=STANDARD
    ADC_DMA1_CH12_ISR: is-reentrant=true, is-synchronous=true, call-type=INTERRUPT, execution-context=INTERRUPT-CAT-1, sw-service-impl-policy=STANDARD
    ADC_DMA1_CH12_CAT2_ISR: is-reentrant=true, is-synchronous=true, call-type=INTERRUPT, execution-context=INTERRUPT-CAT-2, sw-service-impl-policy=STANDARD
    ADC_DMA1_CH13_ISR: is-reentrant=true, is-synchronous=true, call-type=INTERRUPT, execution-context=INTERRUPT-CAT-1, sw-service-impl-policy=STANDARD
    ADC_DMA1_CH13_CAT2_ISR: is-reentrant=true, is-synchronous=true, call-type=INTERRUPT, execution-context=INTERRUPT-CAT-2, sw-service-impl-policy=STANDARD
    ADC_DMA1_CH14_ISR: is-reentrant=true, is-synchronous=true, call-type=INTERRUPT, execution-context=INTERRUPT-CAT-1, sw-service-impl-policy=STANDARD
    ADC_DMA1_CH14_CAT2_ISR: is-reentrant=true, is-synchronous=true, call-type=INTERRUPT, execution-context=INTERRUPT-CAT-2, sw-service-impl-policy=STANDARD
    ADC_DMA1_CH15_ISR: is-reentrant=true, is-synchronous=true, call-type=INTERRUPT, execution-context=INTERRUPT-CAT-1, sw-service-impl-policy=STANDARD
    ADC_DMA1_CH15_CAT2_ISR: is-reentrant=true, is-synchronous=true, call-type=INTERRUPT, execution-context=INTERRUPT-CAT-2, sw-service-impl-policy=STANDARD
    Adc_Init: service-id=0, is-reentrant=false, is-synchronous=true, call-type=REGULAR, execution-context=TASK, sw-service-impl-policy=STANDARD
    Adc_DeInit: service-id=1, is-reentrant=false, is-synchronous=true, call-type=REGULAR, execution-context=TASK, sw-service-impl-policy=STANDARD
    Adc_StartGroupConversion: service-id=2, is-reentrant=true, is-synchronous=false, call-type=REGULAR, execution-context=TASK, sw-service-impl-policy=STANDARD
    Adc_StopGroupConversion: service-id=3, is-reentrant=true, is-synchronous=true, call-type=REGULAR, execution-context=TASK, sw-service-impl-policy=STANDARD
    Adc_ReadGroup: service-id=4, is-reentrant=true, is-synchronous=true, call-type=REGULAR, execution-context=TASK, sw-service-impl-policy=STANDARD
    Adc_EnableHardwareTrigger: service-id=5, is-reentrant=true, is-synchronous=true, call-type=REGULAR, execution-context=TASK, sw-service-impl-policy=STANDARD
    Adc_DisableHardwareTrigger: service-id=6, is-reentrant=true, is-synchronous=true, call-type=REGULAR, execution-context=TASK, sw-service-impl-policy=STANDARD
    Adc_EnableGroupNotification: service-id=7, is-reentrant=true, is-synchronous=true, call-type=REGULAR, execution-context=TASK, sw-service-impl-policy=STANDARD
    Adc_DisableGroupNotification: service-id=8, is-reentrant=true, is-synchronous=true, call-type=REGULAR, execution-context=TASK, sw-service-impl-policy=STANDARD
    Adc_GetGroupStatus: service-id=9, is-reentrant=true, is-synchronous=true, call-type=REGULAR, execution-context=TASK, sw-service-impl-policy=STANDARD
    Adc_GetStreamLastPointer: service-id=11, is-reentrant=true, is-synchronous=true, call-type=REGULAR, execution-context=TASK, sw-service-impl-policy=STANDARD
    Adc_GetVersionInfo: service-id=10, is-reentrant=true, is-synchronous=true, call-type=REGULAR, execution-context=TASK, sw-service-impl-policy=MACRO
    Adc_SetupResultBuffer: service-id=12, is-reentrant=true, is-synchronous=true, call-type=REGULAR, execution-context=TASK, sw-service-impl-policy=STANDARD
    Adc_DisableChannel: service-id=160, is-reentrant=true, is-synchronous=true, call-type=REGULAR, execution-context=TASK, sw-service-impl-policy=STANDARD
    Adc_EnableChannel: service-id=161, is-reentrant=true, is-synchronous=true, call-type=REGULAR, execution-context=TASK, sw-service-impl-policy=STANDARD
