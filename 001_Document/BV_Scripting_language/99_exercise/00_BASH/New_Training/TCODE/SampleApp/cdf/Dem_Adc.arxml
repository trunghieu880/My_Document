AUTOSAR XML (schema 4-2-2)
package /ActiveEcuC
  module config Dem: implementation-config-variant=VARIANT-PRE-COMPILE
    DemConfigSet
      6 x DemEventParameter, all with DemEventKind=(unset), DemMaxNumberFreezeFrameRecords=(unset), DemDTCClassRef=(unset), DemExtendedDataClassRef=(unset), DemFreezeFrameClassRef=(unset), DemFreezeFrameRecNumClassRef=(unset):
        DemEventParameter: DemEventId=1
        DemEventParameter_001: DemEventId=2
        DemEventParameter_002: DemEventId=3
        DemEventParameter_004: DemEventId=5
        DemEventParameter_003: DemEventId=4
        DemEventParameter_005: DemEventId=6
    DemGeneral:
      DemAgingCycleCounterProcessing = (unset)
      DemBswErrorBufferSize = (unset)
      DemClearDTCBehavior = (unset)
      DemDTCSuppressionSupport = true
      DemDebounceCounterBasedSupport = true
      DemDebounceTimeBasedSupport = true
      DemDevErrorDetect = false
      DemDtcStatusAvailabilityMask = (unset)
      DemEnableConditionSupport = true
      DemEventCombinationSupport = (unset)
      DemEventDisplacementSupport = true
      DemExtendedDataCapture = (unset)
      DemFreezeFrameCapture = (unset)
      DemHeaderFileInclusion = (unset)
      DemImmediateNvStorageLimit = (unset)
      DemMaxNumberEventEntryMirror = (unset)
      DemMaxNumberEventEntryPermanent = (unset)
      DemMaxNumberEventEntryPrimary = (unset)
      DemMaxNumberEventEntrySecondary = (unset)
      DemMaxNumberPrestoredFF = (unset)
      DemOBDSupport = true
      DemOccurrenceCounterProcessing = (unset)
      DemOperationCycleStatusStorage = true
      DemPTOSupport = true
      DemStatusBitStorageTestFailed = true
      DemStorageConditionSupport = true
      DemTaskTime = (unset)
      DemTriggerDcmReports = true
      DemTriggerDltReports = true
      DemTriggerFiMReports = true
      DemTriggerMonitorInitBeforeClearOk = true
      DemTypeOfDTCSupported = (unset)
      DemTypeOfFreezeFrameRecordNumeration = (unset)
      DemVersionInfoApi = true
      DemMILIndicatorRef = (unset)
